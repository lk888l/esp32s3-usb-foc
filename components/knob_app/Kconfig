## components/knob_app/Kconfig
```kconfig
menu "SmartKnob"
choice KNOB_TRANSPORT
    prompt "Tuning transport"
    default KNOB_CONSOLE_USB
config KNOB_CONSOLE_UART
    bool "DevKitC COM port (UART0 GPIO43/44, 115200)"
config KNOB_CONSOLE_USB
    bool "Native USB Serial/JTAG (GPIO19/20)"
    help
        Connect to the board USB connector, not the COM/UART bridge.
        USB console logging alone does not receive SmartKnob commands.
        Keep console logs off the tuning transport to preserve JSON frames.
endchoice
choice KNOB_PWM_PROFILE
    prompt "PWM and current sampling profile"
    default KNOB_PWM_20K65
config KNOB_PWM_20K90
    bool "20 kHz / 90 percent (experimental, insufficient sampling windows)"
    help
        Uses 0-90 percent phase duty with no minimum pulse floor. The lowest
        phase is clamped low and the linear voltage circle is 0.9*Vbus/sqrt(3).
        Current sampling still validates each measured low-side window; this
        voltage reduction alone does not guarantee a valid window at all angles.
config KNOB_PWM_20K65
    bool "20 kHz / 65 percent (ADC acquisition window reserved)"
    help
        Derives maximum phase duty from the shared ADC acquisition envelope:
        6 us settling, START at -2.25 us, ADC1_DONE observation budget at +7 us,
        1 us rising-edge guard and 0.5 us reserve. At 20 kHz this gives 65%
        duty and a 17.5 us minimum low-side window. The voltage circle is
        0.65*Vbus/sqrt(3), with the lowest phase clamped low and no pulse floor.
        Actual sample checks remain active; exceptional ISR delays are rejected.
        Conversion completion is observed independently of GDMA callback latency.
config KNOB_PWM_20K100
    bool "20 kHz / full-range SVPWM (experimental, reduced sampling windows)"
    help
        Uses 0-100 percent phase duty and a Vbus/sqrt(3) linear voltage circle.
        The current loop follows measured bus voltage automatically. Low-side
        current samples outside their phase windows are rejected and recovered
        without latching a sampling-window or control-period fault. High duty
        can cause repeated feedback recovery and interrupted torque. The
        default 65 percent profile reserves the ADC acquisition window.
config KNOB_PWM_10K50
    bool "10 kHz / 50 percent (existing same-window sampling)"
config KNOB_PWM_5K70
    bool "5 kHz / 70 percent (voltage capability bench test)"
config KNOB_PWM_20K70
    bool "20 kHz / 70 percent (experimental samples across PWM cycles)"
    help
        One conversion in each of three consecutive carrier cycles. The two
        current measurements have about 50 us skew, so load and dynamic
        validation are required before relying on this mode for haptics.
        A phase may remain low while other active pulses stay at least 4%.
        This increases the low-side window at the same line-to-line voltage.
endchoice
choice KNOB_CONTROL_RATE
    prompt "PWM-synchronous current/control rate"
    default KNOB_CONTROL_5KHZ
config KNOB_CONTROL_2KHZ
    bool "2 kHz (500 us; controlled comparison)"
    depends on KNOB_PWM_10K50
config KNOB_CONTROL_5KHZ
    bool "5 kHz (200 us)"
endchoice
config KNOB_CONTROL_HZ
    int
    default 2000 if KNOB_CONTROL_2KHZ
    default 5000
    help
        ADC bursts and the control task follow PWM events at this rate.
        The sampling-window experiment uses 10 kHz PWM; encoder wake cadence stays
        at 2.5 kHz, so a rate comparison does not also change encoder timing.
config KNOB_BUS_VOLTAGE_SENSE
    bool "Read divided bus voltage on GPIO11 (ADC2_CH0)"
    default y
    help
        Enable only after connecting driver H1-10 (0.1_VCC) to GPIO11 and
        checking the divided voltage against ground. Never connect VM directly.
        The documented board uses 47 kohm / 4.7 kohm, a ratio of 11, not 10.
        A separate core-0 task reads ADC2; phase-current ADC1 DMA is unchanged.
        Invalid or stale measurements inhibit output; there is no manual
        fallback when this option is enabled. The supported bus range is 4.5-30 V.
config KNOB_BUS_DIVIDER_MILLI
    int "Bus divider voltage ratio x 1000"
    depends on KNOB_BUS_VOLTAGE_SENSE
    range 10000 12000
    default 11000
    help
        Vbus / Vadc times 1000. The 47 kohm / 4.7 kohm divider requires 11000.
        Correct for measured divider tolerance only after comparison with an
        external voltmeter. ADC conversion uses the chip's calibrated voltage.
config KNOB_PHASE_RESISTANCE_MILLIOHM
    int "Nominal phase resistance for current feedforward (milliohm, 0 = off)"
    range 0 20000
    default 0
    help
        R * target current supplies the winding's resistive voltage immediately;
        the PI corrects error and back-EMF. Leave this at 0 for the new 22008
        motor until its phase resistance is measured. The previous 4500 value
        was the approximate V/I ratio of the old 2804 with sense_gain=0.15 V/A.
        Recheck after changing motor or sense gain. The voltage circle still applies.
config KNOB_HOST_LEASE_MS
    int "Host command lease (ms, 0 = standalone operation)"
    range 0 60000
    default 0
    help
        Zero keeps explicitly enabled haptics running without USB polling.
        Disable and hardware/control faults still stop the bridge immediately.
config KNOB_ALLOW_WEAK_MAGNET
    bool "Allow AS5600 ML (weak magnet) while MD is set"
    default n
    help
        Applies only when encoder_config.hpp selects the AS5600 backend.
        MT6701 SSI always rejects abnormal field status and loss of track.
        User-approved mechanical constraint: report ML as a warning. Missing
        magnet, strong-field overflow, I2C errors and angle jumps still fault.
config KNOB_DIAGNOSTICS
    bool "Enable bounded FreeRTOS motor release tests"
    default n
    help
        Builds an idle test task and explicit diagnose/read commands. Each test
        uses the normal current regulator, records on-board samples, stops and
        restores the prior configuration. Never starts a test at boot.
endmenu
```

## sdkconfig.defaults
```kconfig
CONFIG_IDF_TARGET="esp32s3"
# CONFIG_ESPTOOLPY_FLASHSIZE_4MB is not set
CONFIG_FREERTOS_HZ=1000
CONFIG_ESP_DEFAULT_CPU_FREQ_MHZ_240=y
CONFIG_ESP_CONSOLE_NONE=y
CONFIG_ESP_CONSOLE_SECONDARY_NONE=y
CONFIG_COMPILER_OPTIMIZATION_PERF=y
CONFIG_ADC_CONTINUOUS_ISR_IRAM_SAFE=y
CONFIG_KNOB_PHASE_RESISTANCE_MILLIOHM=0
CONFIG_KNOB_HOST_LEASE_MS=0
CONFIG_MCPWM_ISR_CACHE_SAFE=y
CONFIG_MCPWM_CTRL_FUNC_IN_IRAM=y
CONFIG_ESP_MAIN_TASK_STACK_SIZE=8192
CONFIG_LOG_DEFAULT_LEVEL_WARN=y
CONFIG_KNOB_CONSOLE_USB=y
CONFIG_KNOB_PWM_20K65=y
CONFIG_KNOB_BUS_VOLTAGE_SENSE=y
CONFIG_KNOB_BUS_DIVIDER_MILLI=11000
CONFIG_ADC_ONESHOT_CTRL_FUNC_IN_IRAM=y
CONFIG_KNOB_ALLOW_WEAK_MAGNET=y

CONFIG_ESPTOOLPY_FLASHSIZE_16MB=y

# Keep USB/protocol code cached alongside the IRAM-resident 5 kHz controller.
CONFIG_ESP32S3_INSTRUCTION_CACHE_32KB=y
```
